// SPDX-License-Identifier: (GPL-2.0+ OR MIT)
/*
 * Really TVI2340R RK3588 live-streaming box, vendor 5.10/6.1.
 *
 * Derived from the factory Android 12 / vendor 5.10 DTB.
 * The built-in panel is driven by DSI1 and scanned at 1920x1080.
 * Source SHA256: d516e8f62ce040e76cab2cbc394dbe46ab53f3f82e9cec1ed8e5714f51358521
 */

/dts-v1/;

#include <dt-bindings/clock/rk3588-cru.h>
#include <dt-bindings/gpio/gpio.h>
#include <dt-bindings/input/linux-event-codes.h>
#include <dt-bindings/interrupt-controller/arm-gic.h>
#include <dt-bindings/interrupt-controller/irq.h>
#include <dt-bindings/leds/common.h>
#include <dt-bindings/power/rk3588-power.h>
#include <dt-bindings/pinctrl/rockchip.h>
#include <dt-bindings/pwm/pwm.h>
#include "rk3588.dtsi"
#include "rk3588-rk806-single.dtsi"
#include "rk3588-linux.dtsi"

/ {
	model = "Really TVI2340R RK3588 Live Streaming Box";

	compatible = "rockchip,rk3588-tvi2340r", "rockchip,rk3588";

	adc-keys {
		compatible = "adc-keys";
		io-channels = <&saradc 1>;
		io-channel-names = "buttons";
		keyup-threshold-microvolt = <1800000>;
		poll-interval = <100>;

		button-back {
			label = "Back";
			linux,code = <KEY_BACK>;
			press-threshold-microvolt = <1235000>;
		};

		button-menu {
			label = "Menu";
			linux,code = <KEY_MENU>;
			press-threshold-microvolt = <890000>;
		};

		button-vol-down {
			label = "Volume Down";
			linux,code = <KEY_VOLUMEDOWN>;
			press-threshold-microvolt = <417000>;
		};

		button-vol-up {
			label = "Volume Up";
			linux,code = <KEY_VOLUMEUP>;
			press-threshold-microvolt = <17000>;
		};
	};

	aliases {
		mmc0 = &sdhci;
		mmc1 = &sdmmc;
		serial2 = &uart2;
	};

	backlight_lvds: backlight-lvds {
		compatible = "pwm-backlight";
		status = "disabled";
		brightness-levels = <0 20 21 22 24 26 28 31 34 38 42 47 52 58 65
				     72 80 89 99 110 122 135 150 166 184 204 226 255>;
		default-brightness-level = <20>;
		enable-gpios = <&gpio3 RK_PB4 GPIO_ACTIVE_HIGH>;
		pinctrl-names = "default";
		pinctrl-0 = <&lt9211_backlight_pin>;
		power-supply = <&vcc_3v3_s3>;
		pwms = <&pwm12 0 1000000 0>;
	};

	chosen {
		stdout-path = "serial2:1500000n8";
		/delete-property/ bootargs;
	};

	es8388-sound {
		compatible = "rockchip,multicodecs-card";
		hp-con-gpio = <&gpio4 RK_PB4 GPIO_ACTIVE_HIGH>;
		linein-det-gpio = <&gpio1 RK_PB6 GPIO_ACTIVE_HIGH>;
		rockchip,audio-routing = "Headphone", "LOUT1",
			"Headphone", "ROUT1",
			"Speaker", "LOUT2",
			"Speaker", "ROUT2",
			"LINPUT1", "Main Mic",
			"LINPUT2", "Main Mic";
		rockchip,card-name = "es8388";
		rockchip,codec = <&es8388>;
		rockchip,cpu = <&i2s1_8ch>;
		rockchip,format = "i2s";
		rockchip,mclk-fs = <256>;
		spk-con-gpio = <&gpio4 RK_PB2 GPIO_ACTIVE_LOW>;
	};

	ext_cam_clk: external-camera-clock {
		compatible = "fixed-clock";
		clock-frequency = <27000000>;
		clock-output-names = "CLK_CAMERA_27MHZ";
		#clock-cells = <0>;
	};

	hdmi1-sound {
		status = "okay";
		compatible = "rockchip,hdmi";
		rockchip,card-name = "hdmi1";
		rockchip,codec = <&hdmi1>;
		rockchip,cpu = <&i2s6_8ch>;
		rockchip,mclk-fs = <128>;
	};

	hdmiin_dc: hdmiin-dc {
		compatible = "rockchip,dummy-codec";
		#sound-dai-cells = <0>;
	};

	hdmiin-sound {
		compatible = "simple-audio-card";
		simple-audio-card,format = "i2s";
		simple-audio-card,name = "rockchip,hdmiin";
		simple-audio-card,bitclock-master = <&hdmiin_dc>;
		simple-audio-card,frame-master = <&hdmiin_dc>;
		status = "okay";

		simple-audio-card,cpu {
			sound-dai = <&i2s7_8ch>;
		};

		simple-audio-card,codec {
			sound-dai = <&hdmiin_dc>;
		};
	};

	leds {
		compatible = "gpio-leds";

		power-led {
			label = "power";
			color = <LED_COLOR_ID_GREEN>;
			gpios = <&gpio3 RK_PC0 GPIO_ACTIVE_HIGH>;
			linux,default-trigger = "heartbeat";
		};
	};

	lvds_panel: panel-lvds {
		compatible = "panel-lvds";
		status = "disabled";
		backlight = <&backlight_lvds>;
		data-mapping = "vesa-24";
		height-mm = <194>;
		power-supply = <&lvds_pwr_en>;
		width-mm = <344>;

		panel-timing {
			clock-frequency = <148500000>;
			hactive = <1920>;
			vactive = <1080>;
			hfront-porch = <88>;
			hsync-len = <44>;
			hback-porch = <148>;
			vfront-porch = <4>;
			vsync-len = <5>;
			vback-porch = <36>;
			hsync-active = <1>;
			vsync-active = <1>;
			de-active = <0>;
			pixelclk-active = <0>;
		};

		port {
			panel_lvds_in: endpoint {
				remote-endpoint = <&lt9211_out>;
			};
		};
	};

	lvds_pwr_en: regulator-lvds-pwr-en {
		compatible = "regulator-fixed";
		enable-active-high;
		gpio = <&gpio3 RK_PB6 GPIO_ACTIVE_HIGH>;
		pinctrl-names = "default";
		pinctrl-0 = <&lvds_pwren_pin>;
		regulator-always-on;
		regulator-boot-on;
		regulator-name = "lvds_pwr_en";
	};

	vcc_1v1_nldo_s3: regulator-vcc-1v1-nldo-s3 {
		compatible = "regulator-fixed";
		regulator-name = "vcc_1v1_nldo_s3";
		regulator-always-on;
		regulator-boot-on;
		regulator-min-microvolt = <1100000>;
		regulator-max-microvolt = <1100000>;
		vin-supply = <&vcc5v0_sys>;
	};

	vcc_sd: regulator-vcc-sd {
		compatible = "regulator-fixed";
		enable-active-high;
		gpio = <&gpio4 RK_PC3 GPIO_ACTIVE_HIGH>;
		pinctrl-names = "default";
		pinctrl-0 = <&sdmmc_pwr>;
		regulator-name = "vcc_sd";
		regulator-min-microvolt = <3300000>;
		regulator-max-microvolt = <3300000>;
		startup-delay-us = <100000>;
		vin-supply = <&vcc_3v3_s3>;
	};

	vcc12v_dcin: regulator-vcc12v-dcin {
		compatible = "regulator-fixed";
		regulator-name = "vcc12v_dcin";
		regulator-always-on;
		regulator-boot-on;
		regulator-min-microvolt = <12000000>;
		regulator-max-microvolt = <12000000>;
	};

	vcc5v0_sys: regulator-vcc5v0-sys {
		compatible = "regulator-fixed";
		regulator-name = "vcc5v0_sys";
		regulator-always-on;
		regulator-boot-on;
		regulator-min-microvolt = <5000000>;
		regulator-max-microvolt = <5000000>;
		vin-supply = <&vcc12v_dcin>;
	};

/*
 * Really carries an SGM760B-style external watchdog on GPIO0_D3.  The
 * factory DTB keeps both this device and the RK3588 DW watchdog disabled.
 */
	watchdog_ext: watchdog-gpio {
		compatible = "linux,wdt-gpio";
		gpios = <&gpio0 RK_PD3 GPIO_ACTIVE_HIGH>;
		pinctrl-names = "default";
		pinctrl-0 = <&sgm760b_power>;
		hw_algo = "level";
		hw_margin_ms = <500>;
		always-running;
		status = "disabled";
	};
};

&av1d {
	status = "okay";
};

&av1d_mmu {
	status = "okay";
};

&combphy0_ps {
	status = "okay";
};

&combphy2_psu {
	status = "okay";
};

&cpu_b0 {
	cpu-supply = <&vdd_cpu_big0_s0>;
	mem-supply = <&vdd_cpu_big0_s0>;
};

&cpu_b1 {
	cpu-supply = <&vdd_cpu_big0_s0>;
	mem-supply = <&vdd_cpu_big0_s0>;
};

&cpu_b2 {
	cpu-supply = <&vdd_cpu_big1_s0>;
	mem-supply = <&vdd_cpu_big1_s0>;
};

&cpu_b3 {
	cpu-supply = <&vdd_cpu_big1_s0>;
	mem-supply = <&vdd_cpu_big1_s0>;
};

&cpu_l0 {
	cpu-supply = <&vdd_cpu_lit_s0>;
	mem-supply = <&vdd_cpu_lit_mem_s0>;
};

&cpu_l1 {
	cpu-supply = <&vdd_cpu_lit_s0>;
	mem-supply = <&vdd_cpu_lit_mem_s0>;
};

&cpu_l2 {
	cpu-supply = <&vdd_cpu_lit_s0>;
	mem-supply = <&vdd_cpu_lit_mem_s0>;
};

&cpu_l3 {
	cpu-supply = <&vdd_cpu_lit_s0>;
	mem-supply = <&vdd_cpu_lit_mem_s0>;
};

&csi2_dcphy0 {
	status = "okay";
};

&csi2_dphy0 {
	status = "okay";
	rockchip,hw = <&csi2_dphy0_hw>;

	ports {
		#address-cells = <1>;
		#size-cells = <0>;

		port@0 {
			#address-cells = <1>;
			#size-cells = <0>;
			reg = <0>;

			mipidphy0_in_lt6911: endpoint@1 {
				reg = <1>;
				data-lanes = <1 2 3 4>;
				remote-endpoint = <&lt6911_out>;
			};
		};

		port@1 {
			#address-cells = <1>;
			#size-cells = <0>;
			reg = <1>;

			csidphy0_out: endpoint@0 {
				reg = <0>;
				remote-endpoint = <&mipi2_csi2_input>;
			};
		};
	};
};

&dp0 {
	status = "okay";
};

&dp0_in_vp1 {
	status = "okay";
};

&dsi1 {
	/* LT9211 bridge driver missing in vendor 6.1; disabled so rockchip-drm can bind with HDMI alone. */
	status = "disabled";

	ports {
		#address-cells = <1>;
		#size-cells = <0>;

		port@1 {
			reg = <1>;

			dsi1_out_bridge: endpoint {
				remote-endpoint = <&lt9211_in>;
			};
		};
	};
};

&dsi1_in_vp3 {
	status = "disabled";
};

&edp0 {
	status = "okay";
};

&edp0_in_vp2 {
	status = "okay";
};

/* Restore factory-enabled infrastructure and use the normal 8250 console. */
&fiq_debugger {
	status = "disabled";
};

&gmac0 {
	clock_in_out = "output";
	phy-handle = <&rgmii_phy0>;
	phy-mode = "rgmii-rxid";
	pinctrl-names = "default";
	pinctrl-0 = <&gmac0_miim
		     &gmac0_tx_bus2
		     &gmac0_rx_bus2
		     &gmac0_rgmii_clk
		     &gmac0_rgmii_bus>;
	snps,reset-active-low;
	snps,reset-delays-us = <0 20000 100000>;
	snps,reset-gpio = <&gpio2 RK_PC4 GPIO_ACTIVE_LOW>;
	status = "okay";
	tx_delay = <0x44>;
};

&gpu {
	mali-supply = <&vdd_gpu_s0>;
	sram-supply = <&vdd_gpu_mem_s0>;
	status = "okay";
};

&hdmi1 {
	pinctrl-names = "default";
	pinctrl-0 = <&hdmim2_tx1_cec &hdmim0_tx1_hpd
		     &hdmim2_tx1_scl &hdmim2_tx1_sda>;
	enable-gpios = <&gpio3 RK_PC5 GPIO_ACTIVE_HIGH>;
	/*
	 * Factory DTB forces HDMI output (HPD line is not wired to the SoC).
	 * vendor 6.1 dw_hdmi_qp uses force-output + force_timing (1080p60).
	 */
	force-output;
	status = "okay";

	force_timing: force_timing {
		clock-frequency = <148500000>;
		hactive = <1920>;
		hfront-porch = <88>;
		hsync-len = <44>;
		hback-porch = <148>;
		vactive = <1080>;
		vfront-porch = <4>;
		vsync-len = <5>;
		vback-porch = <36>;
		hsync-active = <1>;
		vsync-active = <1>;
		de-active = <0>;
		pixelclk-active = <0>;
	};

};

&hdmi1_in_vp0 {
	status = "okay";
};

&hdmirx_ctrler {
	hpd-trigger-level = <1>;
	hdmirx-det-gpios = <&gpio4 RK_PC6 GPIO_ACTIVE_LOW>;
	pinctrl-names = "default";
	pinctrl-0 = <&hdmim1_rx &hdmirx_det>;
	status = "okay";
};

&hdptxphy0 {
	status = "okay";
};

&hdptxphy1 {
	status = "okay";
};

&i2c0 {
	pinctrl-names = "default";
	pinctrl-0 = <&i2c0m2_xfer>;
	status = "okay";

	vdd_cpu_big0_s0: regulator@42 {
		compatible = "rockchip,rk8602";
		reg = <0x42>;
		fcs,suspend-voltage-selector = <1>;
		regulator-name = "vdd_cpu_big0_s0";
		regulator-always-on;
		regulator-boot-on;
		regulator-min-microvolt = <550000>;
		regulator-max-microvolt = <1050000>;
		regulator-ramp-delay = <2300>;
		vin-supply = <&vcc5v0_sys>;
	};

	vdd_cpu_big1_s0: regulator@43 {
		compatible = "rockchip,rk8603", "rockchip,rk8602";
		reg = <0x43>;
		fcs,suspend-voltage-selector = <1>;
		regulator-name = "vdd_cpu_big1_s0";
		regulator-always-on;
		regulator-boot-on;
		regulator-min-microvolt = <550000>;
		regulator-max-microvolt = <1050000>;
		regulator-ramp-delay = <2300>;
		vin-supply = <&vcc5v0_sys>;
	};
};

&i2c1 {
	pinctrl-names = "default";
	pinctrl-0 = <&i2c1m2_xfer>;
	status = "okay";

	vdd_npu_s0: regulator@42 {
		compatible = "rockchip,rk8602";
		reg = <0x42>;
		fcs,suspend-voltage-selector = <1>;
		regulator-name = "vdd_npu_s0";
		regulator-always-on;
		regulator-boot-on;
		regulator-min-microvolt = <550000>;
		regulator-max-microvolt = <950000>;
		regulator-ramp-delay = <2300>;
		vin-supply = <&vcc5v0_sys>;
	};
};

&i2c3 {
	clock-frequency = <100000>;
	pinctrl-names = "default";
	pinctrl-0 = <&i2c3m0_xfer>;
	status = "okay";

	es8388: es8388@11 {
		compatible = "everest,es8388", "everest,es8323";
		reg = <0x11>;
		#sound-dai-cells = <0>;
		clocks = <&cru I2S1_8CH_MCLKOUT>;
		clock-names = "mclk";
		assigned-clocks = <&cru I2S1_8CH_MCLKOUT>;
		assigned-clock-rates = <12288000>;
		pinctrl-names = "default";
		pinctrl-0 = <&i2s1m0_mclk>;
	};
};

&i2c4 {
	clock-frequency = <400000>;
	pinctrl-names = "default";
	pinctrl-0 = <&i2c4m1_xfer>;
	status = "okay";

	lt9211: bridge@2d {
		compatible = "lontium,lt9211";
		reg = <0x2d>;
		status = "disabled";
		reset-gpios = <&gpio3 RK_PA6 GPIO_ACTIVE_HIGH>;
		vccio-supply = <&vcc_1v8_s3>;

		ports {
			#address-cells = <1>;
			#size-cells = <0>;

			port@0 {
				reg = <0>;

				lt9211_in: endpoint {
					data-lanes = <1 2 3 4>;
					remote-endpoint = <&dsi1_out_bridge>;
				};
			};

			port@2 {
				reg = <2>;

				lt9211_out: endpoint {
					remote-endpoint = <&panel_lvds_in>;
				};
			};
		};
	};

	gt9xx: touchscreen@14 {
		compatible = "goodix,gt9110";
		reg = <0x14>;
		interrupt-parent = <&gpio4>;
		interrupts = <RK_PB0 IRQ_TYPE_LEVEL_LOW>;
		reset-gpios = <&gpio1 RK_PD3 GPIO_ACTIVE_LOW>;
		irq-gpios = <&gpio4 RK_PB0 GPIO_ACTIVE_LOW>;
		power-supply = <&vcc_3v3_s3>;
		pinctrl-names = "default";
		pinctrl-0 = <&gt9xx_gpios>;
		touchscreen-size-x = <1920>;
		touchscreen-size-y = <1080>;
	};

	hym8563: rtc@51 {
		compatible = "haoyu,hym8563";
		reg = <0x51>;
		#clock-cells = <0>;
		clock-frequency = <32768>;
		clock-output-names = "hym8563";
		interrupt-parent = <&gpio0>;
		interrupts = <RK_PB0 IRQ_TYPE_LEVEL_LOW>;
		pinctrl-names = "default";
		pinctrl-0 = <&hym8563_int>;
		wakeup-source;
	};
};

&i2c6 {
	status = "okay";

	lt6911: lt6911@2b {
		compatible = "lontium,lt6911uxc2";
		reg = <0x2b>;
		clocks = <&ext_cam_clk>;
		clock-names = "xvclk";
		interrupt-parent = <&gpio1>;
		interrupts = <RK_PC7 IRQ_TYPE_LEVEL_LOW>;
		reset-gpios = <&gpio3 RK_PA7 GPIO_ACTIVE_HIGH>;
		hpd-ctl-gpios = <&gpio2 RK_PC3 GPIO_ACTIVE_HIGH>;
		pinctrl-names = "default";
		pinctrl-0 = <&lt6911_pins>;
		power-domains = <&power RK3588_PD_VI>;
		rockchip,camera-module-index = <1>;
		rockchip,camera-module-facing = "back";
		rockchip,camera-module-name = "lt6911uxc2";
		rockchip,camera-module-lens-name = "NC";
		status = "okay";

		port {
			lt6911_out: endpoint {
				data-lanes = <1 2 3 4>;
				remote-endpoint = <&mipidphy0_in_lt6911>;
			};
		};
	};
};

&i2s1_8ch {
	pinctrl-names = "default";
	pinctrl-0 = <&i2s1m1_lrck
		     &i2s1m1_mclk
		     &i2s1m1_sclk
		     &i2s1m1_sdi0
		     &i2s1m1_sdo0>;
	status = "okay";
};

&i2s6_8ch {
	status = "okay";
};

&i2s7_8ch {
	status = "okay";
};

&iep {
	status = "okay";
};

&iep_mmu {
	status = "okay";
};

&isp0_mmu {
	status = "okay";
};

&jpegd {
	status = "okay";
};

&jpegd_mmu {
	status = "okay";
};

&jpege0 {
	status = "okay";
};

&jpege0_mmu {
	status = "okay";
};

&jpege1 {
	status = "okay";
};

&jpege1_mmu {
	status = "okay";
};

&jpege2 {
	status = "okay";
};

&jpege2_mmu {
	status = "okay";
};

&jpege3 {
	status = "okay";
};

&jpege3_mmu {
	status = "okay";
};

&jpege_ccu {
	status = "okay";
};

&mdio0 {
	rgmii_phy0: ethernet-phy@1 {
		compatible = "ethernet-phy-ieee802.3-c22";
		reg = <1>;
	};
};

&mipi2_csi2 {
	status = "okay";

	ports {
		#address-cells = <1>;
		#size-cells = <0>;

		port@0 {
			#address-cells = <1>;
			#size-cells = <0>;
			reg = <0>;

			mipi2_csi2_input: endpoint@1 {
				reg = <1>;
				remote-endpoint = <&csidphy0_out>;
			};
		};

		port@1 {
			#address-cells = <1>;
			#size-cells = <0>;
			reg = <1>;

			mipi2_csi2_output: endpoint@0 {
				reg = <0>;
				remote-endpoint = <&cif_mipi2_in>;
			};
		};
	};
};

/* SoC-wide accelerators are board-independent and are enabled in the factory DTB. */
&mpp_srv {
	status = "okay";
};

&pcie2x1l1 {
	status = "okay";
};

&pcie2x1l2 {
	status = "okay";
};

&pinctrl {
	lt6911 {
		lt6911_pins: lt6911-pins {
			rockchip,pins = <3 RK_PA7 RK_FUNC_GPIO &pcfg_pull_none>,
					<2 RK_PC3 RK_FUNC_GPIO &pcfg_pull_none>;
		};
	};

	hdmirx {
		hdmirx_det: hdmirx-det {
			rockchip,pins = <4 RK_PC6 RK_FUNC_GPIO &pcfg_pull_up>;
		};
	};

	watchdog {
		sgm760b_power: sgm760b-power {
			rockchip,pins = <0 RK_PD3 RK_FUNC_GPIO &pcfg_pull_none>;
		};
	};

	gt9xx {
		gt9xx_gpios: gt9xx-gpios {
			rockchip,pins = <1 RK_PD3 RK_FUNC_GPIO &pcfg_pull_up>,
					<4 RK_PB0 RK_FUNC_GPIO &pcfg_pull_up>;
		};
	};

	hym8563 {
		hym8563_int: hym8563-int {
			rockchip,pins = <0 RK_PB0 RK_FUNC_GPIO &pcfg_pull_up>;
		};
	};

	lvds {
		lvds_pwren_pin: lvds-pwren-pin {
			rockchip,pins = <3 RK_PB6 RK_FUNC_GPIO &pcfg_pull_none>;
		};
	};

	lt9211 {
		lt9211_backlight_pin: lt9211-backlight-pin {
			rockchip,pins = <3 RK_PB4 RK_FUNC_GPIO &pcfg_pull_none>;
		};
	};

	sdmmc {
		sdmmc_pwr: sdmmc-pwr {
			rockchip,pins = <4 RK_PC3 RK_FUNC_GPIO &pcfg_pull_none>;
		};
	};
};

/* pinctrl comes from the dtsi default ("active" + pwm12m0_pins); overriding
 * the name to "default" broke the pwm chip registration and, by way of the
 * deferred backlight and panel, held up the whole rockchip-drm aggregate. */
&pwm12 {
	status = "okay";
};

&pwm2 {
	status = "okay";
};

&pwm6 {
	status = "okay";
};

&rga2 {
	status = "okay";
};

&rga3_0_mmu {
	status = "okay";
};

&rga3_1_mmu {
	status = "okay";
};

&rga3_core0 {
	status = "okay";
};

&rga3_core1 {
	status = "okay";
};

&rkcif {
	status = "okay";
};

&rkcif_mipi_lvds {
	status = "okay";
};

&rkcif_mipi_lvds2 {
	status = "okay";

	port {
		cif_mipi2_in: endpoint {
			data-lanes = <1 2 3 4>;
			remote-endpoint = <&mipi2_csi2_output>;
		};
	};
};

&rkcif_mipi_lvds_sditf {
	status = "okay";
};

&rkcif_mmu {
	status = "okay";
};

&rkisp0 {
	status = "okay";
};

&rkisp0_vir0 {
	status = "okay";
};

&rknpu {
	npu-supply = <&vdd_npu_s0>;
	status = "okay";
};

&rknpu_mmu {
	status = "okay";
};

&rkvdec0 {
	status = "okay";
};

&rkvdec0_mmu {
	status = "okay";
};

&rkvdec1 {
	status = "okay";
};

&rkvdec1_mmu {
	status = "okay";
};

&rkvdec_ccu {
	status = "okay";
};

&rkvenc0 {
	status = "okay";
};

&rkvenc0_mmu {
	status = "okay";
};

&rkvenc1 {
	status = "okay";
};

&rkvenc1_mmu {
	status = "okay";
};

&rkvenc_ccu {
	status = "okay";
};

&rockchip_suspend {
	status = "okay";
};

&route_dp0 {
	status = "okay";
};

&route_dsi1 {
	connect = <&vp3_out_dsi1>;
	status = "disabled";
};

&route_edp0 {
	status = "okay";
};

&route_hdmi1 {
	connect = <&vp0_out_hdmi1>;
	status = "okay";
};

&saradc {
	vref-supply = <&vcc_1v8_s0>;
	status = "okay";
};

&sdhci {
	bus-width = <8>;
	no-sdio;
	no-sd;
	non-removable;
	mmc-hs400-1_8v;
	mmc-hs400-enhanced-strobe;
	status = "okay";
};

&sdmmc {
	max-frequency = <150000000>;
	bus-width = <4>;
	cap-sd-highspeed;
	disable-wp;
	no-mmc;
	no-sdio;
	sd-uhs-sdr104;
	vmmc-supply = <&vcc_sd>;
	vqmmc-supply = <&vccio_sd_s0>;
	status = "okay";
};

&tsadc {
	status = "okay";
};

&u2phy0 {
	status = "okay";
};

&u2phy0_otg {
	status = "okay";
};

&u2phy1 {
	status = "okay";
};

&u2phy1_otg {
	status = "okay";
};

&u2phy2 {
	status = "okay";
};

&u2phy2_host {
	status = "okay";
};

&u2phy3 {
	status = "okay";
};

&u2phy3_host {
	status = "okay";
};

/* UART0 pins (m2) collide with SPI2-CS0 (gpio0-9) wired to the RK806 PMIC. */
&uart0 {
	status = "disabled";
};

&uart2 {
	pinctrl-names = "default";
	pinctrl-0 = <&uart2m0_xfer>;
	status = "okay";
};

&uart7 {
	status = "okay";
};

&usb_host0_ehci {
	status = "okay";
};

&usb_host0_ohci {
	status = "okay";
};

&usb_host1_ehci {
	status = "okay";
};

&usb_host1_ohci {
	status = "okay";
};

&usbdp_phy0 {
	status = "okay";
};

&usbdp_phy0_dp {
	status = "okay";
};

&usbdp_phy0_u3 {
	status = "okay";
};

&usbdp_phy1 {
	status = "okay";
};

&usbdp_phy1_u3 {
	status = "okay";
};

&usbdrd3_0 {
	status = "okay";
};

&usbdrd3_1 {
	status = "okay";
};

&usbdrd_dwc3_0 {
	status = "okay";
};

&usbdrd_dwc3_1 {
	status = "okay";
};

&vdpu {
	status = "okay";
};

&vdpu_mmu {
	status = "okay";
};

&vepu {
	status = "okay";
};

&vop {
	vop-supply = <&vdd_log_s0>;
	status = "okay";
};

&vop_mmu {
	status = "okay";
};
