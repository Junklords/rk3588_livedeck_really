// SPDX-License-Identifier: (GPL-2.0+ OR MIT)
/*
 * Really TVI2340R RK3588 livestream box -- Linux 7.3 mainline device tree.
 */

/dts-v1/;

#include <dt-bindings/gpio/gpio.h>
#include <dt-bindings/interrupt-controller/irq.h>
#include <dt-bindings/leds/common.h>
#include <dt-bindings/power/rk3588-power.h>
#include <dt-bindings/pwm/pwm.h>
#include <dt-bindings/soc/rockchip,vop2.h>
#include <dt-bindings/thermal/thermal.h>
#include <dt-bindings/usb/pd.h>
#include "rk3588.dtsi"

/ {
	model = "Really TVI2340R RK3588 Live Streaming Box";

	compatible = "rockchip,rk3588-tvi2340r", "rockchip,rk3588";

	/* PMU0 GRF reboot-mode: 与 U-Boot 0003 补丁配对,支持 reboot sd/emmc/usb/loader。
	 * 来源: DeepSeek 镜像 DTB (syscon@fd588000), 公开仓 dts 同步 v85 时缺失, 此处补回。 */
	pmu0_grf: syscon@fd588000 {
		compatible = "rockchip,rk3588-pmu0-grf", "syscon", "simple-mfd";
		reg = <0x0 0xfd588000 0x0 0x2000>;

		reboot-mode {
			compatible = "syscon-reboot-mode";
			offset = <0x80>;
			mode-bootloader = <0x5242c301>;
			mode-loader = <0x5242c301>;
			mode-normal = <0x5242c300>;
			mode-recovery = <0x5242c303>;
			mode-emmc = <0x5242c311>;
			mode-nvme = <0x5242c310>;
			mode-sd = <0x5242c312>;
			mode-tf = <0x5242c312>;
			mode-usb = <0x5242c313>;
		};
	};

	adc-keys {
		compatible = "adc-keys";
		io-channels = <&saradc 1>;
		io-channel-names = "buttons";
		keyup-threshold-microvolt = <1800000>;
		poll-interval = <100>;

		button-vol-down {
			label = "volume down";
			linux,code = <114>;	/* KEY_VOLUMEDOWN */
			press-threshold-microvolt = <417000>;
		};

		button-back {
			label = "back";
			linux,code = <158>;
			press-threshold-microvolt = <1235000>;
		};

		button-menu {
			label = "menu";
			linux,code = <139>;
			press-threshold-microvolt = <890000>;
		};

		button-vol-up {
			label = "volume up";
			linux,code = <115>;	/* KEY_VOLUMEUP */
			press-threshold-microvolt = <17000>;
		};
	};

	play-pause-keys {
		compatible = "adc-keys";
		io-channels = <&saradc 3>;
		io-channel-names = "buttons";
		keyup-threshold-microvolt = <1800000>;
		poll-interval = <100>;

		play-pause-key {
			label = "playpause";
			linux,code = <164>;	/* KEY_PLAYPAUSE */
			press-threshold-microvolt = <200000>;
		};
	};

	aliases {
		ethernet0 = &gmac0;
		mmc0 = &sdhci;
		mmc1 = &sdmmc;
		mmc2 = &sdio;
	};

	backlight: backlight {
		compatible = "pwm-backlight";
		pwms = <&pwm12 0 1000000 0>;
		brightness-levels = <0 255 254 253 252 251 250 249 248 247 246 245 244 243 242 241
				     240 239 238 237 236 235 234 233 232 231 230 229 228 227 226 225
				     224 223 222 221 220 219 218 217 216 215 214 213 212 211 210 209
				     208 207 206 205 204 203 202 201 200 199 198 197 196 195 194 193
				     192 191 190 189 188 187 186 185 184 183 182 181 180 179 178 177
				     176 175 174 173 172 171 170 169 168 167 166 165 164 163 162 161
				     160 159 158 157 156 155 154 153 152 151 150 149 148 147 146 145
				     144 143 142 141 140 139 138 137 136 135 134 133 132 131 130 129
				     128 127 126 125 124 123 122 121 120 119 118 117 116 115 114 113
				     112 111 110 109 108 107 106 105 104 103 102 101 100 99 98 97
				     96 95 94 93 92 91 90 89 88 87 86 85 84 83 82 81
				     80 79 78 77 76 75 74 73 72 71 70 69 68 67 66 65
				     64 63 62 61 60 59 58 57 56 55 54 53 52 51 50 49
				     48 47 46 45 44 43 42 41 40 39 38 38 37 37 36 36
				     35 35 34 34 33 33 32 32 31 31 30 30 29 29 28 28
				     27 27 26 26 25 25 24 24 23 23 22 22 21 21 20 20>;
		default-brightness-level = <154>;
		enable-gpios = <&gpio3 RK_PB4 GPIO_ACTIVE_LOW>;
		pinctrl-names = "default";
		pinctrl-0 = <&backlight_en>;
		power-supply = <&vcc_3v3_s3>;
		status = "okay";
	};

	/* eDP 背光: 与已验证镜像对齐, 默认 disabled (eDP0 实验链, SSH 迭代期再启用) */
	backlight_edp: backlight-edp {
		compatible = "pwm-backlight";
		brightness-levels = <0 20 21 22 24 26 28 31 34 38 42 47 52 58
				     65 72 80 89 99 110 122 135 150 166 184 204 226 255>;
		default-brightness-level = <16>;
		enable-gpios = <&gpio4 RK_PB6 GPIO_ACTIVE_HIGH>;
		pinctrl-names = "default";
		pinctrl-0 = <&edp_backlight_en>;
		power-supply = <&vcc_3v3_s3>;
		pwms = <&pwm6 0 25000 0>;
		status = "disabled";
	};

	chosen {
		stdout-path = "serial2:1500000n8";
	};

	ext_cam_clk: external-camera-clock {
		compatible = "fixed-clock";
		clock-frequency = <27000000>;
		clock-output-names = "CLK_CAMERA_27MHZ";
		#clock-cells = <0>;
	};

	/*
	 * The AP6275P LPO is a hardware 32.768 kHz clock.  HYM8563 may not
	 * answer on I2C early enough (or at all on a cold boot), but its clock
	 * output is autonomous.  Do not make WiFi/Bluetooth probe depend on
	 * the RTC driver being ready.
	 */
	wifi_lpo: wifi-lpo {
		compatible = "fixed-clock";
		clock-frequency = <32768>;
		clock-output-names = "wifi-lpo";
		#clock-cells = <0>;
	};

	hdmi1-con {
		compatible = "hdmi-connector";
		status = "okay";
		type = "a";

		port {
			hdmi1_con_in: endpoint {
				remote-endpoint = <&hdmi1_out_con>;
			};
		};
	};

	panel_lvds: panel-lvds {
		compatible = "panel-lvds";
		backlight = <&backlight>;
		data-mapping = "vesa-24";
		height-mm = <194>;
		power-supply = <&lvds_pwr_en>;
		rotation = <270>; /* Counter-clockwise; equals 90 degrees clockwise. */
		status = "okay";
		width-mm = <344>;

		panel-timing {
			clock-frequency = <148500000>;
			hactive = <1920>;
			vactive = <1080>;
			hfront-porch = <88>;
			hsync-len = <44>;
			hback-porch = <148>;
			vfront-porch = <4>;
			vsync-len = <5>;
			vback-porch = <36>;
			hsync-active = <1>;
			vsync-active = <1>;
			de-active = <0>;
			pixelclk-active = <0>;
		};

		/*
		 * The panel is a dual-link LVDS sink.  The vendor driver encodes
		 * this as lt9211,output-mode = <3>, which selects TX PLL 0x2a
		 * and enables both LVDS channels.  The upstream driver instead
		 * discovers it from the graph below.
		 */
		ports {
			#address-cells = <1>;
			#size-cells = <0>;

			port@0 {
				reg = <0>;
				dual-lvds-odd-pixels;
				panel_lvds_in_odd: endpoint {
					remote-endpoint = <&lt9211_out_odd>;
				};
			};

			port@1 {
				reg = <1>;
				dual-lvds-even-pixels;
				panel_lvds_in_even: endpoint {
					remote-endpoint = <&lt9211_out_even>;
				};
			};
		};
	};

	fan: pwm-fan {
		compatible = "pwm-fan";
		cooling-levels = <0 76 153 204>;
		pwms = <&pwm2 0 40000 PWM_POLARITY_INVERTED>;
		#cooling-cells = <2>;
		status = "okay";
	};

	/* typec-extcon 桥: 已验证镜像未包含 (Alt-Mode 实验节点, SSH 迭代期再启用)
	typec_extcon_bridge: typec-extcon {
		compatible = "linux,typec-extcon-bridge";
		mode-switch;
		orientation-switch;
		usb-role-switch;
		svid = /bits/ 16 <0xff01>;
	};
	*/

	lvds_pwr_en: regulator-lvds-pwr-en {
		compatible = "regulator-fixed";
		enable-active-high;
		gpio = <&gpio3 RK_PB6 GPIO_ACTIVE_HIGH>;
		pinctrl-names = "default";
		pinctrl-0 = <&lvds_pwren_pin>;
		regulator-name = "lvds_pwr_en";
		regulator-always-on;
		regulator-boot-on;
	};

	/* LT6911UXC2/HDMI-in 支路总电源 (2026-11-20 实证: 拉高后固件启动、TMDS 锁定) */
	mipi_cam_pwen: regulator-mipi-cam-pwen {
		compatible = "regulator-fixed";
		enable-active-high;
		gpio = <&gpio1 RK_PA2 GPIO_ACTIVE_HIGH>;
		pinctrl-names = "default";
		pinctrl-0 = <&camera_pwen>;
		regulator-name = "mipi_cam_pwen";
		regulator-always-on;
		regulator-boot-on;
	};

	vbus5v0_typec: regulator-vbus5v0-typec {
		compatible = "regulator-fixed";
		enable-active-high;
		gpio = <&gpio1 RK_PD1 GPIO_ACTIVE_HIGH>;
		pinctrl-names = "default";
		pinctrl-0 = <&typec5v_pwren>;
		regulator-name = "vbus5v0_typec";
		regulator-min-microvolt = <5000000>;
		regulator-max-microvolt = <5000000>;
		vin-supply = <&vcc5v0_usb>;
	};

	vcc_1v1_nldo_s3: regulator-vcc-1v1-nldo-s3 {
		compatible = "regulator-fixed";
		regulator-name = "vcc_1v1_nldo_s3";
		regulator-always-on;
		regulator-boot-on;
		regulator-min-microvolt = <1100000>;
		regulator-max-microvolt = <1100000>;
		vin-supply = <&vcc5v0_sys>;
	};

	vcc_sd: regulator-vcc-sd {
		compatible = "regulator-fixed";
		enable-active-high;
		gpio = <&gpio4 RK_PC3 GPIO_ACTIVE_HIGH>;
		pinctrl-names = "default";
		pinctrl-0 = <&sdmmc_pwr>;
		regulator-name = "vcc_sd";
		regulator-min-microvolt = <3300000>;
		regulator-max-microvolt = <3300000>;
		startup-delay-us = <100000>;
		vin-supply = <&vcc_3v3_s3>;
	};

	vcc12v_dcin: regulator-vcc12v-dcin {
		compatible = "regulator-fixed";
		regulator-name = "vcc12v_dcin";
		regulator-always-on;
		regulator-boot-on;
		regulator-min-microvolt = <12000000>;
		regulator-max-microvolt = <12000000>;
	};

	vcc3v3_lcd_n: regulator-vcc3v3-lcd-n {
		compatible = "regulator-fixed";
		regulator-name = "vcc3v3_lcd_n";
		regulator-always-on;
		regulator-boot-on;
		regulator-min-microvolt = <3300000>;
		regulator-max-microvolt = <3300000>;
		vin-supply = <&vcc_3v3_s3>;
	};

	vcc3v3_pcie: regulator-vcc3v3-pcie {
		compatible = "regulator-fixed";
		enable-active-high;
		gpio = <&gpio3 RK_PB3 GPIO_ACTIVE_HIGH>;
		pinctrl-names = "default";
		pinctrl-0 = <&pcie2x1l1_pwr_en>;
		regulator-name = "vcc3v3_pcie";
		regulator-always-on;
		regulator-boot-on;
		regulator-min-microvolt = <3300000>;
		regulator-max-microvolt = <3300000>;
		vin-supply = <&vcc_3v3_s3>;
	};

	vcc_5g_module_rst: regulator-vcc-5g-module-rst {
		compatible = "regulator-fixed";
		enable-active-high;
		gpio = <&gpio2 RK_PC5 GPIO_ACTIVE_HIGH>;
		pinctrl-names = "default";
		pinctrl-0 = <&pcie2x1l1_5g_rst>;
		regulator-name = "vcc_5g_module_rst";
		regulator-always-on;
		regulator-boot-on;
	};

	vcc_5g_dpr_ctl: regulator-vcc-5g-dpr-ctl {
		compatible = "regulator-fixed";
		enable-active-high;
		gpio = <&gpio3 RK_PD5 GPIO_ACTIVE_HIGH>;
		pinctrl-names = "default";
		pinctrl-0 = <&vcc_5g_dpr_ctrl_pin>;
		regulator-name = "vcc_5g_dpr_ctl";
	};

	vcc5v0_host: regulator-vcc5v0-host {
		compatible = "regulator-fixed";
		enable-active-high;
		gpio = <&gpio3 RK_PA5 GPIO_ACTIVE_HIGH>;
		pinctrl-names = "default";
		pinctrl-0 = <&vcc5v0_host_en>;
		regulator-name = "vcc5v0_host";
		regulator-always-on;
		regulator-boot-on;
		regulator-min-microvolt = <5000000>;
		regulator-max-microvolt = <5000000>;
		vin-supply = <&vcc5v0_sys>;
	};

	vcc5v0_sys: regulator-vcc5v0-sys {
		compatible = "regulator-fixed";
		regulator-name = "vcc5v0_sys";
		regulator-always-on;
		regulator-boot-on;
		regulator-min-microvolt = <5000000>;
		regulator-max-microvolt = <5000000>;
		vin-supply = <&vcc12v_dcin>;
	};

	vcc5v0_usb: regulator-vcc5v0-usb {
		compatible = "regulator-fixed";
		enable-active-high;
		gpio = <&gpio4 RK_PA6 GPIO_ACTIVE_HIGH>;
		pinctrl-names = "default";
		pinctrl-0 = <&vcc5v0_usb_en>;
		regulator-name = "vcc5v0_usb";
		regulator-always-on;
		regulator-boot-on;
		regulator-min-microvolt = <5000000>;
		regulator-max-microvolt = <5000000>;
		vin-supply = <&vcc5v0_sys>;
	};

	vcc5v0_USB30: regulator-vcc5v0-usb30 {
		compatible = "regulator-fixed";
		regulator-name = "vcc5v0_USB30";
		regulator-min-microvolt = <5000000>;
		regulator-max-microvolt = <5000000>;
		vin-supply = <&vcc5v0_usb>;
		/*
		 * GPIO4_C6 is the primary HDMI RX 5V/HPD detect input on this
		 * board, not a USB VBUS enable.  Keep the legacy USB30 control
		 * disabled so it cannot claim the HPD pin during early probe.
		 */
		status = "disabled";
	};

	vcc5v0_usbdcin: regulator-vcc5v0-usbdcin {
		compatible = "regulator-fixed";
		regulator-name = "vcc5v0_usbdcin";
		regulator-always-on;
		regulator-boot-on;
		regulator-min-microvolt = <5000000>;
		regulator-max-microvolt = <5000000>;
		vin-supply = <&vcc12v_dcin>;
	};

	wifi_vbat: regulator-wifi-vbat {
		compatible = "regulator-fixed";
		enable-active-high;
		gpio = <&gpio0 RK_PC4 GPIO_ACTIVE_HIGH>;
		pinctrl-names = "default";
		pinctrl-0 = <&wifi_poweren_gpio>;
		regulator-name = "wifi_vbat";
		regulator-always-on;
		regulator-boot-on;
		regulator-min-microvolt = <3300000>;
		regulator-max-microvolt = <3300000>;
		startup-delay-us = <100000>;
	};

	headphone_amp: amplifier-headphone {
		compatible = "simple-audio-amplifier";
		enable-gpios = <&gpio4 RK_PB4 GPIO_ACTIVE_HIGH>;
		pinctrl-names = "default";
		pinctrl-0 = <&headphone_amp_en>;
		sound-name-prefix = "Headphones Amplifier";
	};

	speaker_amp: amplifier-speaker {
		compatible = "simple-audio-amplifier";
		enable-gpios = <&gpio4 RK_PB2 GPIO_ACTIVE_LOW>;
		pinctrl-names = "default";
		pinctrl-0 = <&speaker_amp_en>;
		sound-name-prefix = "Speaker Amplifier";
	};

	sound {
		compatible = "simple-audio-card";
		simple-audio-card,name = "Really-ES8388";
		simple-audio-card,format = "i2s";
		simple-audio-card,mclk-fs = <256>;
		simple-audio-card,aux-devs = <&headphone_amp>, <&speaker_amp>;
		simple-audio-card,bitclock-master = <&es8388_master>;
		simple-audio-card,frame-master = <&es8388_master>;
		simple-audio-card,hp-det-gpios = <&gpio4 RK_PB3 GPIO_ACTIVE_HIGH>;
		simple-audio-card,pin-switches = "Headphones", "Speaker";
		pinctrl-names = "default";
		pinctrl-0 = <&headphone_det>;
		simple-audio-card,widgets =
			"Microphone", "Main Mic",
			"Microphone", "Headset Mic",
			"Headphone", "Headphones",
			"Speaker", "Speaker";
		simple-audio-card,routing =
			"Speaker Amplifier INL", "LOUT2",
			"Speaker Amplifier INR", "ROUT2",
			"Speaker", "Speaker Amplifier OUTL",
			"Speaker", "Speaker Amplifier OUTR",
			"Headphones Amplifier INL", "LOUT1",
			"Headphones Amplifier INR", "ROUT1",
			"Headphones", "Headphones Amplifier OUTL",
			"Headphones", "Headphones Amplifier OUTR",
			"LINPUT1", "Main Mic",
			"LINPUT2", "Main Mic",
			"RINPUT1", "Headset Mic",
			"RINPUT2", "Headset Mic";
		status = "okay";

		simple-audio-card,cpu {
			sound-dai = <&i2s1_8ch>;
		};

		es8388_master: simple-audio-card,codec {
			sound-dai = <&es8388>;
			system-clock-frequency = <12288000>;
		};
	};

/*
 * Really carries an SGM760B-style external watchdog on GPIO0_D3.  The
 * factory DTB keeps both this device and the RK3588 DW watchdog disabled.
 */
	watchdog_ext: watchdog-gpio {
		compatible = "linux,wdt-gpio";
		gpios = <&gpio0 RK_PD3 GPIO_ACTIVE_HIGH>;
		pinctrl-names = "default";
		pinctrl-0 = <&sgm760b_power>;
		hw_algo = "level";
		hw_margin_ms = <500>;
		always-running;
		status = "disabled";
	};
};

&combphy0_ps {
	status = "okay";
};

&combphy2_psu {
	status = "okay";
};

&cpu_b0 {
	cpu-supply = <&vdd_cpu_big0_s0>;
};

&cpu_b1 {
	cpu-supply = <&vdd_cpu_big0_s0>;
};

&cpu_b2 {
	cpu-supply = <&vdd_cpu_big1_s0>;
};

&cpu_b3 {
	cpu-supply = <&vdd_cpu_big1_s0>;
};

&cpu_l0 {
	cpu-supply = <&vdd_cpu_lit_s0>;
};

&cpu_l1 {
	cpu-supply = <&vdd_cpu_lit_s0>;
};

&cpu_l2 {
	cpu-supply = <&vdd_cpu_lit_s0>;
};

&cpu_l3 {
	cpu-supply = <&vdd_cpu_lit_s0>;
};

&csi2 {
	status = "okay";

	ports {
		port@0 {
			/delete-property/ #address-cells;
			/delete-property/ #size-cells;
			reg = <0>;

			csi2_input: endpoint {
				data-lanes = <1 2 3 4>;
				remote-endpoint = <&lt6911_out>;
			};
		};
	};
};

&csi_dphy0 {
	status = "okay";
};

&dp0 {
	status = "okay";
};

&dp0_in {
	dp0_in_vp1: endpoint {
		remote-endpoint = <&vp1_out_dp0>;
	};
};

&dp0_out {
	dp0_out_con: endpoint {
		remote-endpoint = <&usbdp_phy0_dp_in>;
	};
};

&dsi1 {
	status = "okay";

	ports {
		port@1 {
			reg = <1>;

			dsi1_out_bridge: endpoint {
				data-lanes = <1 2 3 4>;
				remote-endpoint = <&lt9211_in>;
			};
		};
	};
};

&dsi1_in {
	dsi1_in_vp3: endpoint {
		remote-endpoint = <&vp3_out_dsi1>;
	};
};

&edp0 {
	/*
	 * eDP0 is a factory-supported optional internal panel route on VP2.
	 * 已验证镜像中 eDP0 = disabled（无 aux-bus 面板子树）。本复现镜像对齐之；
	 * aux-bus 面板实验链保留在注释中，SSH 迭代期（fdtput/overlay）再启用。
	 */
	status = "disabled";

	/*
	aux-bus {
		panel {
			compatible = "edp-panel";
			backlight = <&backlight_edp>;
			enable-gpios = <&gpio1 RK_PD0 GPIO_ACTIVE_HIGH>;
			hpd-absent-delay-ms = <120>;
			power-supply = <&vcc_3v3_s3>;
			pinctrl-names = "default";
			pinctrl-0 = <&edp_panel_en>;
			rotation = <270>;

			port {
				panel_in_edp: endpoint {
					remote-endpoint = <&edp0_out_panel>;
				};
			};
		};
	};
	*/
};

/* eDP0 端点接线: 已验证镜像无 (随 eDP0 实验链整体禁用)
&edp0_in {
	edp0_in_vp2: endpoint {
		remote-endpoint = <&vp2_out_edp0>;
	};
};

&edp0_out {
	edp0_out_panel: endpoint {
		remote-endpoint = <&panel_in_edp>;
	};
};
*/

&gmac0 {
	clock_in_out = "output";
	phy-handle = <&rgmii_phy0>;
	phy-mode = "rgmii-rxid";
	pinctrl-names = "default";
	pinctrl-0 = <&gmac0_miim
		     &gmac0_tx_bus2
		     &gmac0_rx_bus2
		     &gmac0_rgmii_clk
		     &gmac0_rgmii_bus>;
	tx_delay = <0x44>;
	status = "okay";
};

&gpu {
	mali-supply = <&vdd_gpu_s0>;
	status = "okay";
};

&hdmi1 {
	frl-enable-gpios = <&gpio3 RK_PC5 GPIO_ACTIVE_LOW>;
	pinctrl-names = "default";
	pinctrl-0 = <&hdmim2_tx1_cec &hdmim0_tx1_hpd
		     &hdmim2_tx1_scl &hdmim2_tx1_sda &hdmi1_tx_on_h>;
	status = "okay";
};

&hdmi1_in {
	hdmi1_in_vp0: endpoint {
		remote-endpoint = <&vp0_out_hdmi1>;
	};
};

&hdmi1_out {
	hdmi1_out_con: endpoint {
		remote-endpoint = <&hdmi1_con_in>;
	};
};

&hdmi1_sound {
	status = "okay";
};

&hdmi_receiver {
	/*
	 * Primary HDMI input, handled by the ported Rockchip vendor HDMIRX
	 * driver (rockchip-hdmirx-vendor).  Property set mirrors the vendor
	 * DT verified working on this box: the "hdmi" interrupt is the
	 * FIQ-routed GIC_SPI 436 and the controller needs its own
	 * reg-names/clock/reset-name scheme.
	 */
	compatible = "rockchip,rk3588-hdmirx-ctrler", "rockchip,hdmirx-ctrler";
	reg-names = "hdmirx_regs";
	interrupts = <GIC_SPI 177 IRQ_TYPE_LEVEL_HIGH 0>,
		     <GIC_SPI 436 IRQ_TYPE_LEVEL_HIGH 0>,
		     <GIC_SPI 179 IRQ_TYPE_LEVEL_HIGH 0>;
	interrupt-names = "cec", "hdmi", "dma";
	clocks = <&cru ACLK_HDMIRX>, <&cru CLK_HDMIRX_AUD>,
		 <&cru CLK_CR_PARA>, <&cru PCLK_HDMIRX>,
		 <&cru CLK_HDMIRX_REF>, <&cru PCLK_S_HDMIRX>,
		 <&cru HCLK_VO1>;
	clock-names = "aclk",
		      "audio",
		      "cr_para",
		      "pclk",
		      "ref",
		      "hclk_s_hdmirx",
		      "hclk_vo1";
	resets = <&cru SRST_A_HDMIRX>, <&cru SRST_P_HDMIRX>,
		 <&cru SRST_HDMIRX_REF>, <&cru SRST_A_HDMIRX_BIU>,
		 <&cru SRST_A_HDMIRX>, <&cru SRST_P_HDMIRX>,
		 <&cru SRST_HDMIRX_REF>, <&cru SRST_A_HDMIRX_BIU>;
	reset-names = "rst_a", "rst_p", "rst_ref", "rst_biu",
		      "axi", "apb", "ref", "biu";
	power-domains = <&power RK3588_PD_VO1>;
	rockchip,grf = <&sys_grf>;
	rockchip,vo1_grf = <&vo1_grf>;
	memory-region = <&hdmi_receiver_cma>;
	hdmirx-det-gpios = <&gpio4 RK_PC6 GPIO_ACTIVE_LOW>;
	hpd-gpios = <&gpio4 RK_PC6 GPIO_ACTIVE_LOW>;
	hpd-is-active-low;
	hpd-trigger-level = <1>;
	pinctrl-names = "default";
	pinctrl-0 = <&hdmim1_rx_cec &hdmim1_rx_hpdin
		     &hdmim1_rx_scl &hdmim1_rx_sda &hdmirx_hpd>;
	status = "okay";
};

&hdmi_receiver_cma {
	status = "okay";
};

&hdptxphy0 {
	status = "okay";
};

&hdptxphy1 {
	status = "okay";
};

&i2c0 {
	pinctrl-names = "default";
	pinctrl-0 = <&i2c0m2_xfer>;
	status = "okay";

	vdd_cpu_big0_s0: regulator@42 {
		compatible = "rockchip,rk8602";
		reg = <0x42>;
		fcs,suspend-voltage-selector = <1>;
		regulator-name = "vdd_cpu_big0_s0";
		regulator-always-on;
		regulator-boot-on;
		regulator-min-microvolt = <550000>;
		regulator-max-microvolt = <1050000>;
		regulator-ramp-delay = <2300>;
		vin-supply = <&vcc5v0_sys>;
	};

	vdd_cpu_big1_s0: regulator@43 {
		compatible = "rockchip,rk8603", "rockchip,rk8602";
		reg = <0x43>;
		fcs,suspend-voltage-selector = <1>;
		regulator-name = "vdd_cpu_big1_s0";
		regulator-always-on;
		regulator-boot-on;
		regulator-min-microvolt = <550000>;
		regulator-max-microvolt = <1050000>;
		regulator-ramp-delay = <2300>;
		vin-supply = <&vcc5v0_sys>;
	};
};

&i2c1 {
	pinctrl-names = "default";
	pinctrl-0 = <&i2c1m2_xfer>;
	status = "okay";

	vdd_npu_s0: regulator@42 {
		compatible = "rockchip,rk8602";
		reg = <0x42>;
		fcs,suspend-voltage-selector = <1>;
		regulator-name = "vdd_npu_s0";
		regulator-always-on;
		regulator-boot-on;
		regulator-min-microvolt = <550000>;
		regulator-max-microvolt = <950000>;
		regulator-ramp-delay = <2300>;
		vin-supply = <&vcc5v0_sys>;
	};
};

&i2c3 {
	pinctrl-names = "default";
	pinctrl-0 = <&i2c3m0_xfer>;
	status = "okay";

	es8388: audio-codec@11 {
		compatible = "everest,es8388", "everest,es8328";
		reg = <0x11>;
		clocks = <&cru I2S1_8CH_MCLKOUT>;
		clock-names = "mclk";
		assigned-clocks = <&cru I2S1_8CH_MCLKOUT>;
		assigned-clock-rates = <12288000>;
		pinctrl-names = "default";
		pinctrl-0 = <&i2s1m0_mclk>;
		AVDD-supply = <&avcc_1v8_s0>;
		DVDD-supply = <&avcc_1v8_s0>;
		HPVDD-supply = <&vcc_3v3_s0>;
		PVDD-supply = <&vcc_3v3_s0>;
		#sound-dai-cells = <0>;
		status = "okay";
	};
};

&i2c4 {
	clock-frequency = <100000>; /* 工厂基准: Android 实测 100kHz */
	pinctrl-names = "default";
	pinctrl-0 = <&i2c4m1_xfer>;
	status = "okay";

	lt9211: bridge@2d {
		compatible = "lontium,lt9211";
		reg = <0x2d>;
		/* reset-gpios 移除: 实测 enable 期复位脉冲会使芯片从总线上消失;
		 * 复位改由下方 gpio-hog 恒高(=Android 生态位: 上电即释放, 永不重打) */
		status = "okay";
		vccio-supply = <&vcc_1v8_s3>;

		ports {
			#address-cells = <1>;
			#size-cells = <0>;

			port@0 {
				reg = <0>;
				lt9211_in: endpoint {
					data-lanes = <1 2 3 4>;
					remote-endpoint = <&dsi1_out_bridge>;
				};
			};

			port@2 {
				reg = <2>;
				lt9211_out_odd: endpoint {
					remote-endpoint = <&panel_lvds_in_odd>;
				};
			};

			port@3 {
				reg = <3>;
				lt9211_out_even: endpoint {
					remote-endpoint = <&panel_lvds_in_even>;
				};
			};
		};
	};

	touchscreen@14 {
		compatible = "goodix,gt9110";
		reg = <0x14>;
		interrupt-parent = <&gpio4>;
		interrupts = <RK_PB0 IRQ_TYPE_LEVEL_LOW>;
		reset-gpios = <&gpio1 RK_PD3 GPIO_ACTIVE_HIGH>;
		irq-gpios = <&gpio4 RK_PB0 GPIO_ACTIVE_HIGH>;
		AVDD28-supply = <&vcc_3v3_s3>;
		VDDIO-supply = <&vcc_1v8_s3>;
		pinctrl-names = "default";
		pinctrl-0 = <&gt9xx_gpios>;
		status = "okay";
		touchscreen-size-x = <1080>;
		touchscreen-size-y = <1920>;
	};

	hym8563: rtc@51 {
		compatible = "haoyu,hym8563";
		reg = <0x51>;
		#clock-cells = <0>;
		clock-frequency = <32768>;
		clock-output-names = "hym8563";
		interrupt-parent = <&gpio0>;
		interrupts = <RK_PB0 IRQ_TYPE_LEVEL_LOW>;
		pinctrl-names = "default";
		pinctrl-0 = <&hym8563_int>;
		status = "okay";
		wakeup-source;
	};
};

&i2c6 {
	pinctrl-names = "default";
	pinctrl-0 = <&i2c6m0_xfer>;
	status = "okay";

	lt6911: bridge@2b {
		compatible = "lontium,lt6911uxc2";
		reg = <0x2b>;
		clocks = <&ext_cam_clk>;
		clock-names = "xvclk";
		interrupt-parent = <&gpio1>;
		interrupts = <RK_PC7 IRQ_TYPE_LEVEL_LOW>;
		reset-gpios = <&gpio3 RK_PA7 GPIO_ACTIVE_HIGH>;
		hpd-ctl-gpios = <&gpio2 RK_PC3 GPIO_ACTIVE_HIGH>;
		pinctrl-names = "default";
		pinctrl-0 = <&lt6911_pins>;
		power-domains = <&power RK3588_PD_VI>;
		power-supply = <&mipi_cam_pwen>;
		rockchip,camera-module-index = <1>;
		rockchip,camera-module-facing = "back";
		rockchip,camera-module-name = "lt6911uxc2";
		rockchip,camera-module-lens-name = "NC";
		status = "okay";

		port {
			lt6911_out: endpoint {
				data-lanes = <1 2 3 4>;
				remote-endpoint = <&csi2_input>;
			};
		};
	};

	usbc0: usb-typec@4e {
		compatible = "hynetek,husb311";
		reg = <0x4e>;
		interrupt-parent = <&gpio0>;
		/* 工厂为 GPIO0_B7; D7 引发中断风暴(typec-dp 报告实证), 2026-11-17 修正 */
		interrupts = <RK_PB7 IRQ_TYPE_LEVEL_LOW>;
		pinctrl-names = "default";
		pinctrl-0 = <&usbc0_int>;
		vbus-supply = <&vbus5v0_typec>;
		/* extcon = <&typec_extcon_bridge>;  ← 已验证镜像无 extcon 桥引用 */
		status = "okay";

		connector {
			compatible = "usb-c-connector";
			label = "USB-C";
			data-role = "dual";
			power-role = "dual";
			try-power-role = "sink";
			pd-revision = /bits/ 8 <0x2 0x0 0x1 0x2>;
			source-pdos = <PDO_FIXED(5000, 3000, PDO_FIXED_USB_COMM)>;
			sink-pdos = <PDO_FIXED(5000, 1000, PDO_FIXED_USB_COMM)>;
			op-sink-microwatt = <1000000>;

			altmodes {
				displayport {
					svid = /bits/ 16 <0xff01>;
					vdo = <0x00001c46>;
				};
			};

			ports {
				#address-cells = <1>;
				#size-cells = <0>;

				port@0 {
					reg = <0>;
					usbc0_hs: endpoint {
						remote-endpoint = <&usb_host0_xhci_hs>;
					};
				};

				port@1 {
					reg = <1>;
					usbc0_ss: endpoint {
						remote-endpoint = <&usbdp_phy0_ss_out>;
					};
				};

				port@2 {
					reg = <2>;
					usbc0_sbu: endpoint {
						remote-endpoint = <&usbdp_phy0_dp_out>;
					};
				};
			};
		};
	};
};

&i2s1_8ch {
	pinctrl-names = "default";
	pinctrl-0 = <&i2s1m0_lrck
		     &i2s1m0_sclk
		     &i2s1m0_sdi0
		     &i2s1m0_sdi2
		     &i2s1m0_sdo0>;
	status = "okay";
};

&i2s6_8ch {
	status = "okay";
};

&mdio0 {
	rgmii_phy0: ethernet-phy@1 {
		compatible = "ethernet-phy-ieee802.3-c22";
		reg = <0x1>;
		reset-gpios = <&gpio2 RK_PC4 GPIO_ACTIVE_LOW>;
		reset-assert-us = <20000>;
		reset-deassert-us = <100000>;
		pinctrl-names = "default";
		pinctrl-0 = <&gmac0_phy_rst>;

		leds {
			#address-cells = <1>;
			#size-cells = <0>;

			led@0 {
				reg = <0>;
				color = <LED_COLOR_ID_YELLOW>;
				function = LED_FUNCTION_LAN;
				linux,default-trigger = "netdev";
			};

			led@1 {
				reg = <1>;
				color = <LED_COLOR_ID_GREEN>;
				function = LED_FUNCTION_LAN;
				linux,default-trigger = "netdev";
			};
		};
	};
};

&mipidcphy1 {
	status = "okay";
};

&package_thermal {
	polling-delay = <1000>;

	trips {
		package_fan0: package-fan0 {
			temperature = <55000>;
			hysteresis = <2000>;
			type = "active";
		};

		package_fan1: package-fan1 {
			temperature = <65000>;
			hysteresis = <2000>;
			type = "active";
		};
	};

	cooling-maps {
		map0 {
			trip = <&package_fan0>;
			cooling-device = <&fan THERMAL_NO_LIMIT 1>;
		};

		map1 {
			trip = <&package_fan1>;
			cooling-device = <&fan 2 THERMAL_NO_LIMIT>;
		};
	};
};

&pcie2x1l1 {
	reset-gpios = <&gpio1 RK_PA7 GPIO_ACTIVE_HIGH>;
	vpcie3v3-supply = <&vcc3v3_pcie>;
	status = "okay";
};

&pcie2x1l2 {
	supports-clkreq;
	reset-gpios = <&gpio3 RK_PB7 GPIO_ACTIVE_HIGH>;
	pinctrl-names = "default";
	pinctrl-0 = <&pcie2x1l2_reset>;
	vpcie3v3-supply = <&wifi_vbat>;
	status = "okay";

	pcie@0,0 {
		reg = <0x400000 0 0 0 0>;
		#address-cells = <3>;
		#size-cells = <2>;
		ranges;
		device_type = "pci";
		bus-range = <0x41 0x4f>;

		wifi@0,0 {
			compatible = "pci14e4,449d",
				     "brcm,bcm43752-fmac",
				     "brcm,bcm4329-fmac";
			reg = <0x410000 0 0 0 0>;
			clocks = <&hym8563>; /* RTC CLKOUT 32.768kHz → AP6275P LPO (2026-11-18 实证) */
			clock-names = "lpo";
		};
	};
};

&pd_gpu {
	domain-supply = <&vdd_gpu_s0>;
};

&pd_npu {
	domain-supply = <&vdd_npu_s0>;
};

&pd_rkvdec0 {
	domain-supply = <&vdd_vdenc_s0>;
};

&pd_rkvdec1 {
	domain-supply = <&vdd_vdenc_s0>;
};

&pd_venc0 {
	domain-supply = <&vdd_vdenc_s0>;
};

&pd_venc1 {
	domain-supply = <&vdd_vdenc_s0>;
};

&pinctrl {
	camera {
		camera_pwen: camera-pwen {
			rockchip,pins = <1 RK_PA2 RK_FUNC_GPIO &pcfg_pull_none>;
		};
	};

	lt6911 {
		lt6911_pins: lt6911-pins {
			rockchip,pins = <3 RK_PA7 RK_FUNC_GPIO &pcfg_pull_none>,
					<2 RK_PC3 RK_FUNC_GPIO &pcfg_pull_none>;
		};
	};

	hdmirx {
		hdmirx_hpd: hdmirx-hpd {
			rockchip,pins = <4 RK_PC6 RK_FUNC_GPIO &pcfg_pull_up>;
		};
	};

	pcie {
		pcie2x1l2_reset: pcie2x1l2-reset {
			rockchip,pins = <3 RK_PB7 RK_FUNC_GPIO &pcfg_pull_none>;
		};

		pcie2x1l1_pwr_en: pcie2x1l1-pwr-en {
			rockchip,pins = <3 RK_PB3 RK_FUNC_GPIO &pcfg_pull_none>;
		};

		pcie2x1l1_5g_rst: pcie2x1l1-5g-rst {
			rockchip,pins = <2 RK_PC5 RK_FUNC_GPIO &pcfg_pull_none>;
		};

		vcc_5g_dpr_ctrl_pin: vcc-5g-dpr-ctrl-pin {
			rockchip,pins = <3 RK_PD5 RK_FUNC_GPIO &pcfg_pull_up>;
		};
	};

	watchdog {
		sgm760b_power: sgm760b-power {
			rockchip,pins = <0 RK_PD3 RK_FUNC_GPIO &pcfg_pull_none>;
		};
	};

	backlight {
		backlight_en: backlight-en {
			rockchip,pins = <3 RK_PB4 RK_FUNC_GPIO &pcfg_pull_none>;
		};
	};

	audio-amp {
		headphone_amp_en: headphone-amp-en {
			rockchip,pins = <4 RK_PB4 RK_FUNC_GPIO &pcfg_pull_none>;
		};

		speaker_amp_en: speaker-amp-en {
			rockchip,pins = <4 RK_PB2 RK_FUNC_GPIO &pcfg_pull_none>;
		};

		headphone_det: headphone-det {
			rockchip,pins = <4 RK_PB3 RK_FUNC_GPIO &pcfg_pull_up>;
		};
	};

	ethernet {
		gmac0_phy_rst: gmac0-phy-rst {
			rockchip,pins = <2 RK_PC4 RK_FUNC_GPIO &pcfg_pull_none>;
		};
	};

	edp {
		edp_panel_en: edp-panel-en {
			rockchip,pins = <1 RK_PD0 RK_FUNC_GPIO &pcfg_pull_up>;
		};

		edp_backlight_en: edp-backlight-en {
			rockchip,pins = <4 RK_PB6 RK_FUNC_GPIO &pcfg_pull_none>;
		};
	};

	hdmi {
		hdmi1_tx_on_h: hdmi1-tx-on-h {
			rockchip,pins = <3 RK_PC5 RK_FUNC_GPIO &pcfg_pull_none>;
		};
	};

	hym8563 {
		hym8563_int: hym8563-int {
			rockchip,pins = <0 RK_PB0 RK_FUNC_GPIO &pcfg_pull_up>;
		};
	};

	lvds {
		lvds_pwren_pin: lvds-pwren-pin {
			rockchip,pins = <3 RK_PB6 RK_FUNC_GPIO &pcfg_pull_none>;
		};
	};

	sdmmc {
		sdmmc_pwr: sdmmc-pwr {
			rockchip,pins = <4 RK_PC3 RK_FUNC_GPIO &pcfg_pull_none>;
		};
	};

	touch {
		gt9xx_gpios: gt9xx-gpios {
			rockchip,pins = <1 RK_PD3 RK_FUNC_GPIO &pcfg_pull_none>,
					<4 RK_PB0 RK_FUNC_GPIO &pcfg_pull_none>;
		};
	};

	wireless-bluetooth {
		bt_reset_pin: bt-reset-pin {
			rockchip,pins = <0 RK_PC6 RK_FUNC_GPIO &pcfg_pull_none>;
		};

		bt_wake_pin: bt-wake-pin {
			rockchip,pins = <0 RK_PC5 RK_FUNC_GPIO &pcfg_pull_none>;
		};

		bt_wake_host_pin: bt-wake-host-pin {
			rockchip,pins = <0 RK_PA0 RK_FUNC_GPIO &pcfg_pull_up>;
		};
	};

	wireless-wlan {
		wifi_poweren_gpio: wifi-poweren-gpio {
			rockchip,pins = <0 RK_PC4 RK_FUNC_GPIO &pcfg_pull_none>;
		};
	};

	usb {
		usbc0_int: usbc0-int {
			rockchip,pins = <0 RK_PB7 RK_FUNC_GPIO &pcfg_pull_up>;
		};

		typec5v_pwren: typec5v-pwren {
			rockchip,pins = <1 RK_PD1 RK_FUNC_GPIO &pcfg_pull_none>;
		};

		vcc5v0_host_en: vcc5v0-host-en {
			rockchip,pins = <3 RK_PA5 RK_FUNC_GPIO &pcfg_pull_none>;
		};

		vcc5v0_usb_en: vcc5v0-usb-en {
			rockchip,pins = <4 RK_PA6 RK_FUNC_GPIO &pcfg_pull_up>;
		};

	};
};

&gpio0 {
	vcc1v8_sys_hog: vcc1v8-sys-hog {
		gpio-hog;
		gpios = <RK_PC0 GPIO_ACTIVE_HIGH>;
		output-high;
		line-name = "vcc1v8_sys_en";
	};
};

/* I2C4 设备组总使能: 触摸/RTC 支路电源(或缓冲)使能, Android 由 vendor 驱动拉高,
 * 主线无驱动持有导致两设备物理性不应答(2026-11-17 位摆 A/B 实验定案) */
&gpio1 {
	i2c4-dev-en-hog {
		gpio-hog;
		gpios = <RK_PD0 GPIO_ACTIVE_HIGH>;
		output-high;
		line-name = "i2c4-dev-en";
	};
};

&gpio3 {
	lt9211-rst-hold-hog {
		gpio-hog;
		gpios = <RK_PA6 GPIO_ACTIVE_HIGH>;
		output-high;
		line-name = "lt9211-rst-hold";
	};
};

&pwm12 {
	pinctrl-names = "default";
	pinctrl-0 = <&pwm12m0_pins>;
	status = "okay";
};

&pwm2 {
	pinctrl-names = "default";
	pinctrl-0 = <&pwm2m1_pins>;
	status = "okay";
};

&pwm6 {
	pinctrl-names = "default";
	pinctrl-0 = <&pwm6m1_pins>;
	status = "okay";
};

/*
 * RK3588 media and accelerator blocks are SoC-wide features.  Only effective
 * status changes are kept; nodes already enabled by rk3588.dtsi omit status.
 */
&rknn_core_0 {
	npu-supply = <&vdd_npu_s0>;
	sram-supply = <&vdd_npu_s0>;
	status = "okay";
};

&rknn_core_1 {
	npu-supply = <&vdd_npu_s0>;
	sram-supply = <&vdd_npu_s0>;
	status = "okay";
};

&rknn_core_2 {
	npu-supply = <&vdd_npu_s0>;
	sram-supply = <&vdd_npu_s0>;
	status = "okay";
};

&rknn_mmu_0 {
	status = "okay";
};

&rknn_mmu_1 {
	status = "okay";
};

&rknn_mmu_2 {
	status = "okay";
};

&saradc {
	vref-supply = <&avcc_1v8_s0>;
	status = "okay";
};

&sdhci {
	bus-width = <8>;
	no-sd;
	no-sdio;
	non-removable;
	mmc-hs400-1_8v;
	mmc-hs400-enhanced-strobe;
	status = "okay";
};

&sdmmc {
	bus-width = <4>;
	cap-mmc-highspeed;
	cap-sd-highspeed;
	disable-wp;
	no-mmc;
	no-sdio;
	sd-uhs-sdr104;
	vmmc-supply = <&vcc_sd>;
	vqmmc-supply = <&vccio_sd_s0>;
	status = "okay";
};

&spdif_tx2 {
	status = "okay";
};

&spi2 {
	assigned-clocks = <&cru CLK_SPI2>;
	assigned-clock-rates = <200000000>;
	num-cs = <1>;
	pinctrl-names = "default";
	pinctrl-0 = <&spi2m2_pins>, <&spi2m2_cs0>;
	status = "okay";

	pmic@0 {
		compatible = "rockchip,rk806";
		reg = <0x0>;
		spi-max-frequency = <1000000>;
		interrupt-parent = <&gpio0>;
		interrupts = <7 IRQ_TYPE_LEVEL_LOW>;
		pinctrl-names = "default";
		pinctrl-0 = <&pmic_pins>, <&rk806_dvs1_null>,
			    <&rk806_dvs2_null>, <&rk806_dvs3_null>;
		system-power-controller;
		gpio-controller;
		#gpio-cells = <2>;

		vcc1-supply = <&vcc5v0_sys>;
		vcc2-supply = <&vcc5v0_sys>;
		vcc3-supply = <&vcc5v0_sys>;
		vcc4-supply = <&vcc5v0_sys>;
		vcc5-supply = <&vcc5v0_sys>;
		vcc6-supply = <&vcc5v0_sys>;
		vcc7-supply = <&vcc5v0_sys>;
		vcc8-supply = <&vcc5v0_sys>;
		vcc9-supply = <&vcc5v0_sys>;
		vcc10-supply = <&vcc5v0_sys>;
		vcc11-supply = <&vcc_2v0_pldo_s3>;
		vcc12-supply = <&vcc5v0_sys>;
		vcc13-supply = <&vcc_1v1_nldo_s3>;
		vcc14-supply = <&vcc_1v1_nldo_s3>;
		vcca-supply = <&vcc5v0_sys>;

		rk806_dvs1_null: dvs1-null-pins {
			pins = "gpio_pwrctrl1";
			function = "pin_fun0";
		};

		rk806_dvs2_null: dvs2-null-pins {
			pins = "gpio_pwrctrl2";
			function = "pin_fun0";
		};

		rk806_dvs3_null: dvs3-null-pins {
			pins = "gpio_pwrctrl3";
			function = "pin_fun0";
		};

		regulators {
			vdd_gpu_s0: dcdc-reg1 {
				regulator-boot-on;
				regulator-min-microvolt = <550000>;
				regulator-max-microvolt = <950000>;
				regulator-ramp-delay = <12500>;
				regulator-enable-ramp-delay = <400>;
				regulator-name = "vdd_gpu_s0";
			};

			vdd_cpu_lit_s0: dcdc-reg2 {
				regulator-always-on;
				regulator-boot-on;
				regulator-min-microvolt = <550000>;
				regulator-max-microvolt = <950000>;
				regulator-ramp-delay = <12500>;
				regulator-name = "vdd_cpu_lit_s0";
			};

			vdd_log_s0: dcdc-reg3 {
				regulator-always-on;
				regulator-boot-on;
				regulator-min-microvolt = <675000>;
				regulator-max-microvolt = <750000>;
				regulator-ramp-delay = <12500>;
				regulator-name = "vdd_log_s0";
			};

			vdd_vdenc_s0: dcdc-reg4 {
				regulator-always-on;
				regulator-boot-on;
				regulator-min-microvolt = <550000>;
				regulator-max-microvolt = <950000>;
				regulator-ramp-delay = <12500>;
				regulator-name = "vdd_vdenc_s0";
			};

			vdd_ddr_s0: dcdc-reg5 {
				regulator-always-on;
				regulator-boot-on;
				regulator-min-microvolt = <675000>;
				regulator-max-microvolt = <900000>;
				regulator-ramp-delay = <12500>;
				regulator-name = "vdd_ddr_s0";
			};

			vdd2_ddr_s3: dcdc-reg6 {
				regulator-always-on;
				regulator-boot-on;
				regulator-name = "vdd2_ddr_s3";
			};

			vcc_2v0_pldo_s3: dcdc-reg7 {
				regulator-always-on;
				regulator-boot-on;
				regulator-min-microvolt = <2000000>;
				regulator-max-microvolt = <2000000>;
				regulator-ramp-delay = <12500>;
				regulator-name = "vcc_2v0_pldo_s3";
			};

			vcc_3v3_s3: dcdc-reg8 {
				regulator-always-on;
				regulator-boot-on;
				regulator-min-microvolt = <3300000>;
				regulator-max-microvolt = <3300000>;
				regulator-name = "vcc_3v3_s3";
			};

			vddq_ddr_s0: dcdc-reg9 {
				regulator-always-on;
				regulator-boot-on;
				regulator-name = "vddq_ddr_s0";
			};

			vcc_1v8_s3: dcdc-reg10 {
				regulator-always-on;
				regulator-boot-on;
				regulator-min-microvolt = <1800000>;
				regulator-max-microvolt = <1800000>;
				regulator-name = "vcc_1v8_s3";
			};

			avcc_1v8_s0: pldo-reg1 {
				regulator-always-on;
				regulator-boot-on;
				regulator-min-microvolt = <1800000>;
				regulator-max-microvolt = <1800000>;
				regulator-name = "avcc_1v8_s0";
			};

			vcc_1v8_s0: pldo-reg2 {
				regulator-always-on;
				regulator-boot-on;
				regulator-min-microvolt = <1800000>;
				regulator-max-microvolt = <1800000>;
				regulator-name = "vcc_1v8_s0";
			};

			avdd_1v2_s0: pldo-reg3 {
				regulator-always-on;
				regulator-boot-on;
				regulator-min-microvolt = <1200000>;
				regulator-max-microvolt = <1200000>;
				regulator-name = "avdd_1v2_s0";
			};

			vcc_3v3_s0: pldo-reg4 {
				regulator-always-on;
				regulator-boot-on;
				regulator-min-microvolt = <3300000>;
				regulator-max-microvolt = <3300000>;
				regulator-name = "vcc_3v3_s0";
			};

			vccio_sd_s0: pldo-reg5 {
				regulator-always-on;
				regulator-boot-on;
				regulator-min-microvolt = <1800000>;
				regulator-max-microvolt = <3300000>;
				regulator-name = "vccio_sd_s0";
			};

			pldo6_s3: pldo-reg6 {
				regulator-always-on;
				regulator-boot-on;
				regulator-min-microvolt = <1800000>;
				regulator-max-microvolt = <1800000>;
				regulator-name = "pldo6_s3";
			};

			vdd_0v75_s3: nldo-reg1 {
				regulator-always-on;
				regulator-boot-on;
				regulator-min-microvolt = <750000>;
				regulator-max-microvolt = <750000>;
				regulator-name = "vdd_0v75_s3";
			};

			vdd_ddr_pll_s0: nldo-reg2 {
				regulator-always-on;
				regulator-boot-on;
				regulator-min-microvolt = <850000>;
				regulator-max-microvolt = <850000>;
				regulator-name = "vdd_ddr_pll_s0";
			};

			avdd_0v75_s0: nldo-reg3 {
				regulator-always-on;
				regulator-boot-on;
				regulator-min-microvolt = <750000>;
				regulator-max-microvolt = <750000>;
				regulator-name = "avdd_0v75_s0";
			};

			vdd_0v85_s0: nldo-reg4 {
				regulator-always-on;
				regulator-boot-on;
				regulator-min-microvolt = <850000>;
				regulator-max-microvolt = <850000>;
				regulator-name = "vdd_0v85_s0";
			};

			vdd_0v75_s0: nldo-reg5 {
				regulator-always-on;
				regulator-boot-on;
				regulator-min-microvolt = <750000>;
				regulator-max-microvolt = <750000>;
				regulator-name = "vdd_0v75_s0";
			};
		};
	};
};

&tsadc {
	status = "okay";
};

&u2phy0 {
	status = "okay";
};

&u2phy0_otg {
	status = "okay";
};

&u2phy1 {
	status = "okay";
};

&u2phy1_otg {
	phy-supply = <&vcc5v0_host>;
	status = "okay";
};

&u2phy2 {
	status = "okay";
};

&u2phy2_host {
	phy-supply = <&vcc5v0_host>;
	status = "okay";
};

&u2phy3 {
	status = "okay";
};

&u2phy3_host {
	phy-supply = <&vcc5v0_host>;
	status = "okay";
};

&uart0 {
	pinctrl-names = "default";
	pinctrl-0 = <&uart0m2_xfer>;
	status = "okay";
};

&uart2 {
	pinctrl-names = "default";
	pinctrl-0 = <&uart2m0_xfer>;
	status = "okay";
};

&uart7 {
	pinctrl-names = "default";
	pinctrl-0 = <&uart7m1_xfer &uart7m1_ctsn &uart7m1_rtsn>;
	uart-has-rtscts;
	status = "okay";

	bluetooth {
		compatible = "brcm,bcm4345c5";
		clocks = <&wifi_lpo>;
		clock-names = "lpo";
		device-wakeup-gpios = <&gpio0 RK_PC5 GPIO_ACTIVE_HIGH>;
		host-wakeup-gpios = <&gpio0 RK_PA0 GPIO_ACTIVE_HIGH>;
		shutdown-gpios = <&gpio0 RK_PC6 GPIO_ACTIVE_HIGH>;
		interrupt-parent = <&gpio0>;
		interrupts = <RK_PA0 IRQ_TYPE_LEVEL_HIGH>;
		interrupt-names = "host-wakeup";
		max-speed = <1500000>;
		pinctrl-names = "default";
		pinctrl-0 = <&bt_wake_pin &bt_reset_pin &bt_wake_host_pin>;
		vbat-supply = <&vcc_3v3_s3>;
		vddio-supply = <&vcc_1v8_s3>;
	};
};

&usb_host0_ehci {
	status = "okay";
};

&usb_host0_ohci {
	status = "okay";
};

&usb_host0_xhci {
	dr_mode = "otg";
	usb-role-switch;
	status = "okay";

	port {
		#address-cells = <1>;
		#size-cells = <0>;

		usb_host0_xhci_hs: endpoint@0 {
			reg = <0>;
			remote-endpoint = <&usbc0_hs>;
		};

		usb_host0_xhci_ss: endpoint@1 {
			reg = <1>;
			remote-endpoint = <&usbdp_phy0_ss_in>;
		};
	};
};

&usb_host1_ehci {
	status = "okay";
};

&usb_host1_ohci {
	status = "okay";
};

&usb_host1_xhci {
	dr_mode = "host";
	status = "okay";
};

&usbdp_phy0 {
	mode-switch;
	orientation-switch;
	sbu1-dc-gpios = <&gpio3 RK_PA0 GPIO_ACTIVE_HIGH>;
	sbu2-dc-gpios = <&gpio1 RK_PB2 GPIO_ACTIVE_HIGH>;
	rockchip,dp-lane-mux = <2 3>;
	status = "okay";

	port {
		#address-cells = <1>;
		#size-cells = <0>;

		usbdp_phy0_ss_out: endpoint@0 {
			reg = <0>;
			remote-endpoint = <&usbc0_ss>;
		};

		usbdp_phy0_ss_in: endpoint@1 {
			reg = <1>;
			remote-endpoint = <&usb_host0_xhci_ss>;
		};

		usbdp_phy0_dp_in: endpoint@2 {
			reg = <2>;
			remote-endpoint = <&dp0_out_con>;
		};

		usbdp_phy0_dp_out: endpoint@3 {
			reg = <3>;
			remote-endpoint = <&usbc0_sbu>;
		};
	};
};

&usbdp_phy1 {
	status = "okay";
};

&vicap {
	status = "okay";
};

&vicap_mmu {
	status = "okay";
};

&vop {
	assigned-clocks = <&cru DCLK_VOP2_SRC>;
	assigned-clock-parents = <&cru PLL_V0PLL>;
	status = "okay";
};

&vop_mmu {
	status = "okay";
};

&vp0 {
	vp0_out_hdmi1: endpoint@ROCKCHIP_VOP2_EP_HDMI1 {
		reg = <ROCKCHIP_VOP2_EP_HDMI1>;
		remote-endpoint = <&hdmi1_in_vp0>;
	};
};

&vp1 {
	vp1_out_dp0: endpoint@a {
		reg = <ROCKCHIP_VOP2_EP_DP0>;
		remote-endpoint = <&dp0_in_vp1>;
	};
};

/* eDP0 VP2 出口: 已验证镜像无此端点 (随 eDP0 实验链整体禁用)
&vp2 {
	vp2_out_edp0: endpoint@ROCKCHIP_VOP2_EP_EDP0 {
		reg = <ROCKCHIP_VOP2_EP_EDP0>;
		remote-endpoint = <&edp0_in_vp2>;
	};
};
*/

&vp3 {
	vp3_out_dsi1: endpoint@ROCKCHIP_VOP2_EP_MIPI1 {
		reg = <ROCKCHIP_VOP2_EP_MIPI1>;
		remote-endpoint = <&dsi1_in_vp3>;
	};
};



&wdt {
	status = "disabled";
};
